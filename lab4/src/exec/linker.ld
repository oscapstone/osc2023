ENTRY(_start)

SECTIONS
{
    .text : { 
        *(.text.start)
        *(.text)
    }
    .rodata : {
        *(.rodata)
    }
    .data : {
        *(.data)
    }
    .bss : {
        *(.bss)
    }
}